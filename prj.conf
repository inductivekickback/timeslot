## prj.conf
```kconfig
# Configure MPSL
CONFIG_MPSL_LOG_LEVEL_DBG=y
CONFIG_MPSL_TIMESLOT_SESSION_COUNT=1
```

## include/timeslot.h
```c
/*
 * Copyright (c) 2021 Daniel Veilleux
 *
 * SPDX-License-Identifier: LicenseRef-Nordic-5-Clause
 */

#ifndef TIMESLOT_H__
#define TIMESLOT_H__

#ifdef __cplusplus
extern "C" {
#endif

#include <mpsl_timeslot.h>

#define TS_LEN_US               25000
#define RNH_DISTANCE_US         800
#define TS_REQUEST_DELAY_US     1900
#define TS_REQUEST_TOLERANCE_US 300

/**
 * A hardware interrupt vector to use with the Radio Notification feature as well as lowering the
 * priority of the MPSL callback (Zero Latency IRQ workaround). As of NCS v1.6.0 this doesn't
 * handle MPSL_TIMESLOT_SIGNAL_TIMER0 signals correctly unless it uses priority 4 or higher.
 */
#define TIMESLOT_IRQN          QDEC_IRQn
#define TIMESLOT_IRQ_NODELABEL qdec
#define TIMESLOT_IRQ_PRIO      4

/**
 * If TIMESLOT_CALLS_RADIO_IRQHANDLER is set then RADIO_IRQHandler() will be called
 * directly instead of executing the radio_irq callback.
 */
#define TIMESLOT_CALLS_RADIO_IRQHANDLER 1

enum TIMESLOT_ERROR
{
    /**
     * Could not get a granted timeslot using an "earliest" request. len_us is probably
     * too long for the current Connection Interval.
     */
    TIMESLOT_ERROR_REQUESTS_FAILED = 94,
    /** The MPSL complained because the timeslot did not close on time. */
    TIMESLOT_ERROR_OVERSTAYED = 93,
    /** Something unexpected happened. */
    TIMESLOT_ERROR_INTERNAL = 92,
    /** The timeslot_open function was called twice. */
    TIMESLOT_ERROR_SESSION_ALREADY_OPENED = 91,
    /**
     * The timeslot_start function was called before timeslot_stop completed (and executed
     * the stopped callback).
     */
    TIMESLOT_ERROR_TIMESLOT_ALREADY_STARTED = 90,
    /** The timeslot_stop function was called twice. */
    TIMESLOT_ERROR_NO_TIMESLOT_STARTED = 89,
    /** A required pointer was not included in an argument. */
    TIMESLOT_ERROR_INVALID_PARAM = 88
};

struct timeslot_config {
    /**
     * High frequency clock source, see MPSL_TIMESLOT_HFCLK_CFG.
     */
    uint8_t  hfclk;        
    /**
     * Amount of time before a request times out.
     */
    uint32_t timeout_us;
    /**
     * Close the timeslot this amount of time before the end to ensure that it closes cleanly.
     */
    uint32_t  safety_margin_us;
    /**
     * The number of skipped timeslots before an error is raised.
     */
    uint8_t   skipped_tolerance;
};

#define TS_DEFAULT_CONFIG { \
    .hfclk             = MPSL_TIMESLOT_HFCLK_CFG_XTAL_GUARANTEED, \
    .timeout_us        = 2000000, /* Default is 2s. */            \
    .safety_margin_us  = 100, /* Default is 100us */              \
    .skipped_tolerance = 5 /* Default is 5 */                   \
}

struct timeslot_cb {
    /**
     * A (potentially unrecoverable) error has occurred. The err param will be set to a
     * TIMESLOT_ERROR or an error returned by mpsl_timeslot_request.
     */
    void (*error)(int err);
    /**
     * Called at the beginning of every timeslot.
     */
    void (*start)(void);
    /**
     * Called TS_SAFETY_MARGIN_US before the end of every timeslot.
     */
    void (*end)(void);
    /**
     * A timeslot has been blocked or cancelled. The count parameter is set to the number
     * of consecutive timeslots that have been skipped.
     */
    void (*skipped)(uint8_t count);
    /**
     * The recurring timeslot has been stopped (the session is idle).
     */
    void (*stopped)(void);

#if !TIMESLOT_USE_RADIO_IRQHANDLER
    /**
     * Some like e.g. the ESB library defines its own RADIO_IRQHandler function. Setting
     * TIMESLOT_USE_RADIO_IRQHANDLER causes MPSL_TIMESLOT_SIGNAL_RADIO signals to call
     * RADIO_IRQHandler directly. Otherwise, this callback will be used whenever RADIO_IRQHandler
     * is called.
     */
    void (*radio_irq)(void);
#endif
};

/** @brief Open an MPSL session
 * 
 * @note Opening a session is always the first step and closing a session is not implemented
 *       because there's no obvious reason to ever do it.
 * 
 * @param[in] p_config      Pointer to a timeslot_config (should be static/global)
 * @param[in] p_cb          Pointer to a timeslot_cb (should be static/global)
 * 
 * @retval 0                                      Success
 * @retval -TIMESLOT_ERROR_SESSION_ALREADY_OPENED The session is already open
 * @retval -TIMESLOT_ERROR_INVALID_PARAM          One of the pointers was NULL
 */
int timeslot_open(struct timeslot_config *p_config, struct timeslot_cb *p_cb);

/** @brief Request a recurring timeslot of len_us based on the given interval
 * 
 * @param[in] len_us      Usable length will be minus safety_margin_us
 * 
 * @retval 0                                        Success
 * @retval -TIMESLOT_ERROR_TIMESLOT_ALREADY_STARTED The session is already open
 * @retval -NRF_EINVAL                              Invalid parameter
 * @retval -NRF_ENOENT                              The session is not open
 * @retval -NRF_EAGAIN                              The session is not IDLE
 */
int timeslot_start(uint32_t len_us);

/** @brief Stop requesting the recurring timeslot and allow the session to go idle
 *
 * @retval 0                                   Success
 * @retval -TIMESLOT_ERROR_NO_TIMESLOT_STARTED There is no timeslot to stop
 */
int timeslot_stop(void);

#ifdef __cplusplus
}
#endif

#endif /* TIMESLOT_H__ */

/** @} */
```

## src/timeslot.c
```c
/*
 * Copyright (c) 2021 Daniel Veilleux
 *
 * SPDX-License-Identifier: LicenseRef-Nordic-5-Clause
 */

#include <zephyr.h>
#include <stdio.h>

#include <logging/log.h>

#define LOG_MODULE_NAME timeslot
LOG_MODULE_REGISTER(LOG_MODULE_NAME);

#include <mpsl.h>
#include <mpsl_radio_notification.h>
#include <mpsl_timeslot.h>

#define TS_GPIO_DEBUG 1

#if TS_GPIO_DEBUG
#include <hal/nrf_gpio.h>
#define TIMESLOT_OPEN_PIN          4
#define TIMESLOT_BLOCKED_PIN       28
#define TIMESLOT_CANCELLED_PIN     30
#define RADIO_NOTIFICATION_PIN     2
#define REQUEST_PIN                31
#endif

#include <timeslot.h>

#define TIMESLOT_THREAD_STACK_SIZE 768
#define TIMESLOT_THREAD_PRIORITY   5

#define INVALID_MPSL_SIGNAL        11

enum SIGNAL_CODE
{
    SIGNAL_CODE_START             = 0x00,
    SIGNAL_CODE_TIMER0            = 0x01,
    SIGNAL_CODE_RADIO             = 0x02,
    SIGNAL_CODE_BLOCKED_CANCELLED = 0x03,
    SIGNAL_CODE_OVERSTAYED        = 0x04,
    SIGNAL_CODE_IDLE              = 0x05,
    SIGNAL_CODE_RNH_ACTIVE        = 0x06,
    SIGNAL_CODE_UNEXPECTED        = 0x07
};

static uint32_t                ts_len_us;
static uint8_t                 blocked_cancelled_count;
static bool                    session_open;
static bool                    timeslot_started;
static bool                    timeslot_stopping;
static bool                    timeslot_requested;
static uint32_t                mpsl_callback_signal=INVALID_MPSL_SIGNAL;
static struct timeslot_config *p_timeslot_config;
static struct timeslot_cb     *p_timeslot_callbacks;

static struct k_poll_signal timeslot_sig = K_POLL_SIGNAL_INITIALIZER(timeslot_sig);
static struct k_poll_event events[1]     = {
    K_POLL_EVENT_STATIC_INITIALIZER(K_POLL_TYPE_SIGNAL,
                                    K_POLL_MODE_NOTIFY_ONLY,
                                    &timeslot_sig, 0),
};

static mpsl_timeslot_session_id_t mpsl_session_id;

/* NOTE: MPSL return params must be in static scope. */
static mpsl_timeslot_request_t request_earliest = {
    .request_type = MPSL_TIMESLOT_REQ_TYPE_EARLIEST,
    .params.earliest = {
        .priority   = MPSL_TIMESLOT_PRIORITY_NORMAL,
    }
};

static mpsl_timeslot_signal_return_param_t action_none = {
    .callback_action = MPSL_TIMESLOT_SIGNAL_ACTION_NONE
};

static mpsl_timeslot_signal_return_param_t action_end = {
    .callback_action = MPSL_TIMESLOT_SIGNAL_ACTION_END
};

#if TIMESLOT_CALLS_RADIO_IRQHANDLER
void RADIO_IRQHandler(void);
#endif

static mpsl_timeslot_signal_return_param_t*
mpsl_cb(mpsl_timeslot_session_id_t session_id, uint32_t signal)
{
    switch (signal) {
    case MPSL_TIMESLOT_SIGNAL_START:
#if TS_GPIO_DEBUG
        nrf_gpio_pin_write(TIMESLOT_OPEN_PIN, 1);
#endif
        if (timeslot_stopping) {
#if TS_GPIO_DEBUG
            nrf_gpio_pin_write(TIMESLOT_OPEN_PIN, 0);
            nrf_gpio_pin_write(TIMESLOT_OPEN_PIN, 0);
            nrf_gpio_pin_write(TIMESLOT_OPEN_PIN, 0);
            nrf_gpio_pin_write(TIMESLOT_OPEN_PIN, 0);
            nrf_gpio_pin_write(TIMESLOT_OPEN_PIN, 0);
            nrf_gpio_pin_write(TIMESLOT_OPEN_PIN, 0);
            nrf_gpio_pin_write(TIMESLOT_OPEN_PIN, 1);
#endif
            return &action_end;
        }

        /* TIMER0 is pre-configured for 1MHz mode by the MPSL. */
        NRF_TIMER0->CC[0]    = (ts_len_us - p_timeslot_config->safety_margin_us);
        NRF_TIMER0->INTENSET = (TIMER_INTENSET_COMPARE0_Set<<TIMER_INTENSET_COMPARE0_Pos);
        mpsl_callback_signal = MPSL_TIMESLOT_SIGNAL_START;
        NVIC_EnableIRQ(TIMER0_IRQn);
        NVIC_SetPendingIRQ(TIMESLOT_IRQN);
        break;

    case MPSL_TIMESLOT_SIGNAL_TIMER0:
#if TS_GPIO_DEBUG
        nrf_gpio_pin_write(TIMESLOT_OPEN_PIN, 0);
#endif
        NRF_TIMER0->TASKS_STOP = 1;
        mpsl_callback_signal   = MPSL_TIMESLOT_SIGNAL_TIMER0;
        NVIC_SetPendingIRQ(TIMESLOT_IRQN);
        return &action_end;

    case MPSL_TIMESLOT_SIGNAL_RADIO:
        if (timeslot_stopping) {
            return &action_end;
        }
#if TIMESLOT_CALLS_RADIO_IRQHANDLER
        RADIO_IRQHandler();
#else
        mpsl_callback_signal = MPSL_TIMESLOT_SIGNAL_RADIO;
        NVIC_SetPendingIRQ(TIMESLOT_IRQN);
#endif
        break;

    case MPSL_TIMESLOT_SIGNAL_BLOCKED:
#if TS_GPIO_DEBUG
        nrf_gpio_pin_write(TIMESLOT_BLOCKED_PIN, 1);
#endif
        k_poll_signal_raise(&timeslot_sig, SIGNAL_CODE_BLOCKED_CANCELLED);
        break;

    case MPSL_TIMESLOT_SIGNAL_CANCELLED:
#if TS_GPIO_DEBUG
        nrf_gpio_pin_write(TIMESLOT_CANCELLED_PIN, 1);
#endif
        k_poll_signal_raise(&timeslot_sig, SIGNAL_CODE_BLOCKED_CANCELLED);
        break;

    case MPSL_TIMESLOT_SIGNAL_SESSION_IDLE:
        k_poll_signal_raise(&timeslot_sig, SIGNAL_CODE_IDLE);
        break;

    case MPSL_TIMESLOT_SIGNAL_EXTEND_FAILED:
        /* Intentional fall-through */
    case MPSL_TIMESLOT_SIGNAL_EXTEND_SUCCEEDED:
        /* Intentional fall-through */
    case MPSL_TIMESLOT_SIGNAL_INVALID_RETURN:
        /* Intentional fall-through */
    case MPSL_TIMESLOT_SIGNAL_SESSION_CLOSED:
        k_poll_signal_raise(&timeslot_sig, SIGNAL_CODE_UNEXPECTED);
        break;

    case MPSL_TIMESLOT_SIGNAL_OVERSTAYED:
        k_poll_signal_raise(&timeslot_sig, SIGNAL_CODE_OVERSTAYED);
        break;

    default:
        break;
    };

    return &action_none;
}

static void radio_notify_cb(const void *context)
{
    if (!timeslot_started)
    {
        /* Ignore RNH events until the timeslot is started. */
        return;
    }

    if (INVALID_MPSL_SIGNAL != mpsl_callback_signal) {
        /* This is an MPSL callback. */
        switch (mpsl_callback_signal) {
        case MPSL_TIMESLOT_SIGNAL_START:
            k_poll_signal_raise(&timeslot_sig, SIGNAL_CODE_START);
            break;
        case MPSL_TIMESLOT_SIGNAL_RADIO:
            k_poll_signal_raise(&timeslot_sig, SIGNAL_CODE_RADIO);
            break;
        case MPSL_TIMESLOT_SIGNAL_TIMER0:
            k_poll_signal_raise(&timeslot_sig, SIGNAL_CODE_TIMER0);
            break;
        default:
            k_poll_signal_raise(&timeslot_sig, SIGNAL_CODE_UNEXPECTED);
            break;
        };
        mpsl_callback_signal = INVALID_MPSL_SIGNAL;
    } else {
        /* This is a radio notification. */
#if TS_GPIO_DEBUG
        nrf_gpio_pin_set(RADIO_NOTIFICATION_PIN);
        nrf_gpio_pin_set(RADIO_NOTIFICATION_PIN);
        nrf_gpio_pin_set(RADIO_NOTIFICATION_PIN);
        nrf_gpio_pin_set(RADIO_NOTIFICATION_PIN);
        nrf_gpio_pin_set(RADIO_NOTIFICATION_PIN);
        nrf_gpio_pin_set(RADIO_NOTIFICATION_PIN);
        nrf_gpio_pin_clear(RADIO_NOTIFICATION_PIN);
#endif
        k_poll_signal_raise(&timeslot_sig, SIGNAL_CODE_RNH_ACTIVE);
    }
}

int timeslot_stop(void)
{
    if (!session_open || !timeslot_started) {
        return -TIMESLOT_ERROR_NO_TIMESLOT_STARTED;
    }
    timeslot_stopping = true;
    LOG_INF("timeslot_stop()");
    return 0;
}

int timeslot_start(uint32_t len_us)
{
    if (!session_open || timeslot_started || timeslot_stopping) {
        return -TIMESLOT_ERROR_TIMESLOT_ALREADY_STARTED;
    }

    LOG_INF("timeslot_start(len_us: %d)", len_us);
    ts_len_us               = len_us;
    blocked_cancelled_count = 0;
    timeslot_started        = true;

    request_earliest.params.earliest.length_us = len_us;
    return 0;
}

int timeslot_open(struct timeslot_config *p_config, struct timeslot_cb *p_cb)
{
    if (session_open) {
        return -TIMESLOT_ERROR_SESSION_ALREADY_OPENED;
    }

    if (0 == p_config) {
        return -TIMESLOT_ERROR_INVALID_PARAM;
    }

    if ((0 == p_cb) || (0 == p_cb->error) || (0 == p_cb->start) || (0 == p_cb->end)) {
        return -TIMESLOT_ERROR_INVALID_PARAM;
    }
#if !TIMESLOT_CALLS_RADIO_IRQHANDLER
    if (0 == p_cb->radio_irq) {
        return -TIMESLOT_ERROR_INVALID_PARAM;
    }
#endif

    LOG_INF("timeslot_open(...)");
    int err = mpsl_radio_notification_cfg_set(MPSL_RADIO_NOTIFICATION_TYPE_INT_ON_ACTIVE,
                                                MPSL_RADIO_NOTIFICATION_DISTANCE_800US,
                                                TIMESLOT_IRQN);
    if (err) {
        return err;
    }

    IRQ_CONNECT(DT_IRQN(DT_NODELABEL(TIMESLOT_IRQ_NODELABEL)), TIMESLOT_IRQ_PRIO,
                radio_notify_cb, NULL, 0);
    irq_enable(DT_IRQN(DT_NODELABEL(TIMESLOT_IRQ_NODELABEL)));

    p_timeslot_config    = p_config;
    p_timeslot_callbacks = p_cb;

    request_earliest.params.earliest.hfclk      = p_timeslot_config->hfclk;
    request_earliest.params.earliest.timeout_us = p_timeslot_config->timeout_us;

    err = mpsl_timeslot_session_open(mpsl_cb, &mpsl_session_id);
    if (err) {
        return err;
    }

#if TS_GPIO_DEBUG
    nrf_gpio_cfg_output(TIMESLOT_OPEN_PIN);
    nrf_gpio_cfg_output(TIMESLOT_BLOCKED_PIN);
    nrf_gpio_cfg_output(TIMESLOT_CANCELLED_PIN);
    nrf_gpio_cfg_output(RADIO_NOTIFICATION_PIN);
    nrf_gpio_cfg_output(REQUEST_PIN);
    nrf_gpio_pin_clear(TIMESLOT_OPEN_PIN);
    nrf_gpio_pin_clear(TIMESLOT_BLOCKED_PIN);
    nrf_gpio_pin_clear(TIMESLOT_CANCELLED_PIN);
    nrf_gpio_pin_clear(RADIO_NOTIFICATION_PIN);
    nrf_gpio_pin_clear(REQUEST_PIN);
#endif

    session_open = true;
    return 0;
}

static void timeslot_stopped(void) {
#if TS_GPIO_DEBUG
    nrf_gpio_pin_write(TIMESLOT_OPEN_PIN, 0);
#endif
    timeslot_stopping = false;
    timeslot_started  = false;
    p_timeslot_callbacks->stopped();
}

static void timeslot_thread_fn(void)
{
    int err;

    while (true) {
        k_poll(events, 1, K_FOREVER);

        switch (events[0].signal->result) {
        case SIGNAL_CODE_START:
            p_timeslot_callbacks->start();
            blocked_cancelled_count = 0;
            break;

        case SIGNAL_CODE_TIMER0:
            p_timeslot_callbacks->end();
            break;

#if !TIMESLOT_CALLS_RADIO_IRQHANDLER
        case SIGNAL_CODE_RADIO:
            p_timeslot_callbacks->radio_irq();
            break;
#endif

        case SIGNAL_CODE_BLOCKED_CANCELLED:
            timeslot_requested = false;
#if TS_GPIO_DEBUG
            nrf_gpio_pin_write(TIMESLOT_BLOCKED_PIN,   0);
            nrf_gpio_pin_write(TIMESLOT_CANCELLED_PIN, 0);
#endif
            blocked_cancelled_count++;
            if (blocked_cancelled_count > p_timeslot_config->skipped_tolerance) {
                blocked_cancelled_count = 0;
                p_timeslot_callbacks->error(-TIMESLOT_ERROR_REQUESTS_FAILED);
                break;
            }
            if (timeslot_stopping) {
                timeslot_stopped();
                break;
            }
            p_timeslot_callbacks->skipped(blocked_cancelled_count);
            break;

        case SIGNAL_CODE_IDLE:
            timeslot_requested = false;
            if (timeslot_stopping) {
                timeslot_stopped();
            }
            break;

        case SIGNAL_CODE_OVERSTAYED:
            /* This is the most probable of the what-could-go-wrong scenarios. */
            p_timeslot_callbacks->error(-TIMESLOT_ERROR_OVERSTAYED);
            break;

        case SIGNAL_CODE_UNEXPECTED:
            /* Something like MPSL_TIMESLOT_SIGNAL_INVALID_RETURN happened. */
            p_timeslot_callbacks->error(-TIMESLOT_ERROR_INTERNAL);
            break;

        case SIGNAL_CODE_RNH_ACTIVE:
            if (timeslot_requested) {
                break;
            }
#if TS_GPIO_DEBUG
            nrf_gpio_pin_write(REQUEST_PIN, 1);
#endif
            k_sleep(K_USEC(CONFIG_SDC_MAX_CONN_EVENT_LEN_DEFAULT-TS_REQUEST_DELAY_US+RNH_DISTANCE_US));
#if TS_GPIO_DEBUG
            nrf_gpio_pin_write(REQUEST_PIN, 0);
#endif
            timeslot_requested = true;
            err = mpsl_timeslot_request(mpsl_session_id, &request_earliest);
            if (err) {
                p_timeslot_callbacks->error(err);
            }
            break;

        default:
            p_timeslot_callbacks->error(-TIMESLOT_ERROR_INTERNAL);
            break;
        }

        events[0].signal->signaled = 0;
        events[0].state            = K_POLL_STATE_NOT_READY;
    }
}

K_THREAD_DEFINE(timeslot_thread, TIMESLOT_THREAD_STACK_SIZE,
                    timeslot_thread_fn, NULL, NULL, NULL,
                    K_PRIO_COOP(TIMESLOT_THREAD_PRIORITY), 0, 0);
```
